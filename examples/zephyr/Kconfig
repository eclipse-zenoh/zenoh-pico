## examples/zephyr/Kconfig
```kconfig
choice ZP_EXAMPLE
	prompt "Zenoh-Pico example to build"
	default ZP_EXAMPLE_PUB

config ZP_EXAMPLE_PUB
	bool "z_pub: publish on a key expression"
	depends on ZENOH_PICO_PUBLICATION

config ZP_EXAMPLE_SUB
	bool "z_sub: subscribe to a key expression"
	depends on ZENOH_PICO_SUBSCRIPTION

config ZP_EXAMPLE_PULL
	bool "z_pull: pull samples from a subscriber ring buffer"
	depends on ZENOH_PICO_SUBSCRIPTION

config ZP_EXAMPLE_GET
	bool "z_get: send a query"
	depends on ZENOH_PICO_QUERY

config ZP_EXAMPLE_QUERYABLE
	bool "z_queryable: answer queries"
	depends on ZENOH_PICO_QUERYABLE

config ZP_EXAMPLE_SCOUT
	bool "z_scout: scout for Zenoh nodes"
	depends on ZENOH_PICO_SCOUTING

endchoice

source "Kconfig.zephyr"
```

## examples/zephyr/sample.yaml
```yaml
sample:
  name: Zenoh-Pico examples
common:
  tags: zenoh
  build_only: true
  platform_allow:
    - nucleo_f767zi
  integration_platforms:
    - nucleo_f767zi
tests:
  zenoh_pico.z_pub:
    extra_configs:
      - CONFIG_ZP_EXAMPLE_PUB=y
  zenoh_pico.z_sub:
    extra_configs:
      - CONFIG_ZP_EXAMPLE_SUB=y
  zenoh_pico.z_pull:
    extra_configs:
      - CONFIG_ZP_EXAMPLE_PULL=y
  zenoh_pico.z_get:
    extra_configs:
      - CONFIG_ZP_EXAMPLE_GET=y
  zenoh_pico.z_queryable:
    extra_configs:
      - CONFIG_ZP_EXAMPLE_QUERYABLE=y
  zenoh_pico.z_scout:
    extra_configs:
      - CONFIG_ZP_EXAMPLE_SCOUT=y
  zenoh_pico.single_thread:
    extra_configs:
      - CONFIG_ZENOH_PICO_MULTI_THREAD=n
  zenoh_pico.ipv6_only:
    extra_configs:
      - CONFIG_NET_IPV4=n
      - CONFIG_NET_DHCPV4=n
      - CONFIG_NET_CONFIG_NEED_IPV4=n
      - CONFIG_NET_IPV6=y
      - CONFIG_NET_CONFIG_NEED_IPV6=y
  zenoh_pico.serial:
    extra_configs:
      - CONFIG_ZENOH_PICO_LINK_SERIAL=y
  zenoh_pico.all_features:
    extra_configs:
      - CONFIG_ZENOH_PICO_UNSTABLE_API=y
      - CONFIG_ZENOH_PICO_ADVANCED_PUBLICATION=y
      - CONFIG_ZENOH_PICO_ADVANCED_SUBSCRIPTION=y
      - CONFIG_ZENOH_PICO_CONNECTIVITY=y
      - CONFIG_ZENOH_PICO_ADMIN_SPACE=y
      - CONFIG_ZENOH_PICO_LOCAL_SUBSCRIBER=y
      - CONFIG_ZENOH_PICO_LOCAL_QUERYABLE=y
      - CONFIG_ZENOH_PICO_RX_CACHE=y
      - CONFIG_ZENOH_PICO_MULTICAST_DECLARATIONS=y
      - CONFIG_ZENOH_PICO_BATCH_TX_MUTEX=y
      - CONFIG_ZENOH_PICO_BATCH_PEER_MUTEX=y
```

## zephyr/Kconfig.zenoh
```kconfig
menuconfig ZENOH_PICO
	bool "Zenoh-Pico library"
	depends on NETWORKING
	select POSIX_SYSTEM_INTERFACES
	select POSIX_TIMERS
	select POSIX_NETWORKING
	select POSIX_FD_MGMT
	select POSIX_DEVICE_IO
	help
	  Enable Zenoh-Pico support.

	  Defaults mirror the standalone CMake build. Links are enabled
	  automatically when the matching Zephyr networking support is
	  available.

if ZENOH_PICO

config HEAP_MEM_POOL_ADD_SIZE_ZENOH_PICO
	int "Heap memory reserved for Zenoh-Pico"
	default 32768
	help
	  System heap, in bytes, added for Zenoh-Pico sessions and their
	  transmit, receive and defragmentation buffers.

config ZENOH_PICO_UNSTABLE_API
	bool "Unstable API"
	help
	  Enable APIs that are not yet stabilized and may change without
	  notice.

menu "API features"

config ZENOH_PICO_PUBLICATION
	bool "Publication"
	default y

config ZENOH_PICO_SUBSCRIPTION
	bool "Subscription"
	default y

config ZENOH_PICO_QUERY
	bool "Query"
	default y

config ZENOH_PICO_QUERYABLE
	bool "Queryable"
	default y

config ZENOH_PICO_LIVELINESS
	bool "Liveliness"
	default y

config ZENOH_PICO_INTEREST
	bool "Interest protocol"
	default y
	help
	  Lets peers declare interest in key expressions, which enables
	  writer-side filtering and matching status.

config ZENOH_PICO_MATCHING
	bool "Matching status"
	depends on ZENOH_PICO_INTEREST
	default y

config ZENOH_PICO_ENCODING_VALUES
	bool "Predefined encoding values"
	default y

config ZENOH_PICO_SESSION_CHECK
	bool "Publisher/querier session check"
	default y

config ZENOH_PICO_LOCAL_SUBSCRIBER
	bool "Local subscriptions"

config ZENOH_PICO_LOCAL_QUERYABLE
	bool "Local queryables"

config ZENOH_PICO_ADVANCED_PUBLICATION
	bool "Advanced publication"
	depends on ZENOH_PICO_UNSTABLE_API
	depends on ZENOH_PICO_PUBLICATION && ZENOH_PICO_QUERYABLE && ZENOH_PICO_LIVELINESS

config ZENOH_PICO_ADVANCED_SUBSCRIPTION
	bool "Advanced subscription"
	depends on ZENOH_PICO_UNSTABLE_API
	depends on ZENOH_PICO_SUBSCRIPTION && ZENOH_PICO_QUERY && ZENOH_PICO_LIVELINESS

config ZENOH_PICO_CONNECTIVITY
	bool "Connectivity status/events API"
	depends on ZENOH_PICO_UNSTABLE_API

config ZENOH_PICO_ADMIN_SPACE
	bool "Admin space"
	depends on ZENOH_PICO_UNSTABLE_API && ZENOH_PICO_QUERYABLE

endmenu

menu "Transports"

config ZENOH_PICO_UNICAST_TRANSPORT
	bool "Unicast transport"
	default y

config ZENOH_PICO_UNICAST_PEER
	bool "Unicast peer mode"
	depends on ZENOH_PICO_UNICAST_TRANSPORT
	default y

config ZENOH_PICO_MULTICAST_TRANSPORT
	bool "Multicast transport"
	default y

config ZENOH_PICO_MULTICAST_DECLARATIONS
	bool "Multicast resource declarations"
	depends on ZENOH_PICO_MULTICAST_TRANSPORT

config ZENOH_PICO_FRAGMENTATION
	bool "Fragmentation"
	default y

config ZENOH_PICO_BATCHING
	bool "Batching"
	default y

config ZENOH_PICO_BATCH_TX_MUTEX
	bool "Hold the TX mutex for a whole batch"
	depends on ZENOH_PICO_BATCHING && ZENOH_PICO_MULTI_THREAD

config ZENOH_PICO_BATCH_PEER_MUTEX
	bool "Hold the peer mutex for a whole batch"
	depends on ZENOH_PICO_BATCHING && ZENOH_PICO_MULTI_THREAD

config ZENOH_PICO_RX_CACHE
	bool "RX cache"

config ZENOH_PICO_AUTO_RECONNECT
	bool "Automatic reconnection"
	default y

endmenu

menu "Links"

config ZENOH_PICO_LINK_TCP
	bool "TCP link"
	depends on NET_TCP
	default y
	imply DNS_RESOLVER

config ZENOH_PICO_TCP_NODELAY
	bool "Set TCP_NODELAY on TCP links"
	depends on ZENOH_PICO_LINK_TCP
	default y

config ZENOH_PICO_LINK_TLS
	bool "TLS link"
	depends on ZENOH_PICO_LINK_TCP && MBEDTLS

config ZENOH_PICO_LINK_UDP_UNICAST
	bool "UDP unicast link"
	depends on NET_UDP
	default y

config ZENOH_PICO_LINK_UDP_MULTICAST
	bool "UDP multicast link"
	depends on NET_UDP && ZENOH_PICO_MULTICAST_TRANSPORT
	depends on NET_IPV4_IGMP || NET_IPV6_MLD
	default y

config ZENOH_PICO_SCOUTING
	bool "Scouting"
	depends on ZENOH_PICO_LINK_UDP_UNICAST
	default y

config ZENOH_PICO_LINK_SERIAL
	bool "Serial link"
	depends on SERIAL

endmenu

config ZENOH_PICO_MULTI_THREAD
	bool "Multithreading support"
	default y
	select POSIX_THREADS
	select POSIX_CLOCK_SELECTION
	help
	  Run the read and lease tasks in background threads.

config ZENOH_PICO_THREADS_NUM
	int "Number of preallocated pthread stacks"
	depends on ZENOH_PICO_MULTI_THREAD
	default 4
	help
	  Number of preallocated pthread stacks used when no explicit thread
	  attributes are provided (attr == NULL). Stack slots are returned to the
	  pool when threads are joined.

menu "Tuning"

config ZENOH_PICO_FRAG_MAX_SIZE
	int "Maximum size of a defragmented message"
	default 4096

config ZENOH_PICO_BATCH_UNICAST_SIZE
	int "Maximum unicast batch size"
	default 2048

config ZENOH_PICO_BATCH_MULTICAST_SIZE
	int "Maximum multicast batch size"
	default 2048

config ZENOH_PICO_CONFIG_SOCKET_TIMEOUT
	int "Socket timeout (ms)"
	default 100

config ZENOH_PICO_TRANSPORT_LEASE
	int "Lease duration announced to other nodes (ms)"
	default 10000

config ZENOH_PICO_TRANSPORT_LEASE_EXPIRE_FACTOR
	int "Lease expire factor"
	default 3

config ZENOH_PICO_RUNTIME_MAX_TASKS
	int "Maximum number of runtime tasks"
	default 64

config ZENOH_PICO_RUNTIME_IDLE_READ_TASK_SLEEP
	int "Idle read task sleep (ms)"
	default 0

config ZENOH_PICO_TRANSPORT_ACCEPT_TIMEOUT
	int "P2P link accept timeout (ms)"
	default 1000

config ZENOH_PICO_TRANSPORT_CONNECT_TIMEOUT
	int "P2P link connect timeout (ms)"
	default 10000

endmenu

endif
```
